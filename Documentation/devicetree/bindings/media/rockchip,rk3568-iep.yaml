## Documentation/devicetree/bindings/media/rockchip,rk3568-iep.yaml
```yaml
# SPDX-License-Identifier: (GPL-2.0-only OR BSD-2-Clause)
%YAML 1.2
---
$id: http://devicetree.org/schemas/media/rockchip,rk3568-iep.yaml#
$schema: http://devicetree.org/meta-schemas/core.yaml#

title: Rockchip IEP2 image enhancement processor

maintainers:
  - Arun Iyengar <aiyengar1990@gmail.com>

description:
  The IEP2 (image enhancement processor, version 2) found in the Rockchip
  RK3568 and RK3588 SoCs is a memory to memory video deinterlacer. It
  supports intra-field and motion-adaptive, motion-compensated
  deinterlacing of YUV 4:2:0 and 4:2:2 semi-planar frames. It is connected
  to its own IOMMU, with which it shares its interrupt line.

properties:
  compatible:
    oneOf:
      - const: rockchip,rk3568-iep
      - items:
          - const: rockchip,rk3588-iep
          - const: rockchip,rk3568-iep

  reg:
    maxItems: 1

  interrupts:
    maxItems: 1

  clocks:
    items:
      - description: AXI bus clock
      - description: AHB bus clock
      - description: Core clock

  clock-names:
    items:
      - const: aclk
      - const: hclk
      - const: sclk

  resets:
    items:
      - description: AXI reset
      - description: AHB reset
      - description: Core reset

  reset-names:
    items:
      - const: axi
      - const: ahb
      - const: core

  power-domains:
    maxItems: 1

  iommus:
    maxItems: 1

required:
  - compatible
  - reg
  - interrupts
  - clocks
  - clock-names
  - power-domains
  - iommus

additionalProperties: false

examples:
  - |
    #include <dt-bindings/clock/rockchip,rk3588-cru.h>
    #include <dt-bindings/interrupt-controller/arm-gic.h>
    #include <dt-bindings/power/rk3588-power.h>
    #include <dt-bindings/reset/rockchip,rk3588-cru.h>

    bus {
      #address-cells = <2>;
      #size-cells = <2>;

      deinterlace@fdbb0000 {
        compatible = "rockchip,rk3588-iep", "rockchip,rk3568-iep";
        reg = <0x0 0xfdbb0000 0x0 0x500>;
        interrupts = <GIC_SPI 117 IRQ_TYPE_LEVEL_HIGH>;
        clocks = <&cru ACLK_IEP2P0>, <&cru HCLK_IEP2P0>,
                 <&cru CLK_IEP2P0_CORE>;
        clock-names = "aclk", "hclk", "sclk";
        resets = <&cru SRST_A_IEP2P0>, <&cru SRST_H_IEP2P0>,
                 <&cru SRST_IEP2P0_CORE>;
        reset-names = "axi", "ahb", "core";
        power-domains = <&power RK3588_PD_VDPU>;
        iommus = <&iep_mmu>;
      };
    };
```

## Documentation/devicetree/bindings/media/rockchip,rk3588-jpeg-decoder.yaml
```yaml
# SPDX-License-Identifier: (GPL-2.0-only OR BSD-2-Clause)
%YAML 1.2
---
$id: http://devicetree.org/schemas/media/rockchip,rk3588-jpeg-decoder.yaml#
$schema: http://devicetree.org/meta-schemas/core.yaml#

title: Rockchip VDPU720 JPEG decoder

maintainers:
  - Arun Iyengar <aiyengar1990@gmail.com>

description:
  The VDPU720 (also called rkjpegd) is a dedicated baseline JPEG decoder
  found in Rockchip SoCs. It decodes Huffman coded 8-bit JPEG images into
  semi-planar YUV frames and has its own IOMMU.

properties:
  compatible:
    const: rockchip,rk3588-jpeg-decoder

  reg:
    maxItems: 1

  interrupts:
    maxItems: 1

  clocks:
    items:
      - description: AXI bus clock
      - description: AHB interface clock

  clock-names:
    items:
      - const: aclk
      - const: hclk

  resets:
    items:
      - description: AXI bus reset
      - description: AHB interface reset

  reset-names:
    items:
      - const: axi
      - const: ahb

  power-domains:
    maxItems: 1

  iommus:
    maxItems: 1

required:
  - compatible
  - reg
  - interrupts
  - clocks
  - clock-names
  - power-domains

additionalProperties: false

examples:
  - |
    #include <dt-bindings/clock/rockchip,rk3588-cru.h>
    #include <dt-bindings/interrupt-controller/arm-gic.h>
    #include <dt-bindings/interrupt-controller/irq.h>
    #include <dt-bindings/power/rk3588-power.h>
    #include <dt-bindings/reset/rockchip,rk3588-cru.h>

    bus {
        #address-cells = <2>;
        #size-cells = <2>;

        video-codec@fdb90000 {
            compatible = "rockchip,rk3588-jpeg-decoder";
            reg = <0x0 0xfdb90000 0x0 0x400>;
            interrupts = <GIC_SPI 129 IRQ_TYPE_LEVEL_HIGH>;
            clocks = <&cru ACLK_JPEG_DECODER>, <&cru HCLK_JPEG_DECODER>;
            clock-names = "aclk", "hclk";
            resets = <&cru SRST_A_JPEG_DECODER>, <&cru SRST_H_JPEG_DECODER>;
            reset-names = "axi", "ahb";
            iommus = <&jpegd_mmu>;
            power-domains = <&power RK3588_PD_VDPU>;
        };
    };
```

## Documentation/devicetree/bindings/media/rockchip,rk3588-vdec-ccu.yaml
```yaml
# SPDX-License-Identifier: (GPL-2.0-only OR BSD-2-Clause)
%YAML 1.2
---
$id: http://devicetree.org/schemas/media/rockchip,rk3588-vdec-ccu.yaml#
$schema: http://devicetree.org/meta-schemas/core.yaml#

title: Rockchip RK3588 Video Decoder Core Coordination Unit

maintainers:
  - Heiko Stuebner <heiko@sntech.de>

description:
  The RK3588 video decoder has two cores (rockchip,rk3588-vdec). The core
  coordination unit (CCU) lets both cores work on the same stream. While one
  core decodes a frame, the other one can decode the next frame, and the CCU
  holds back its reads of reference pixels and co-located motion vectors
  until the first core has written them.

properties:
  compatible:
    const: rockchip,rk3588-vdec-ccu

  reg:
    maxItems: 1

  clocks:
    maxItems: 1

  resets:
    maxItems: 1

  power-domains:
    maxItems: 1

required:
  - compatible
  - reg
  - clocks
  - power-domains

additionalProperties: false

examples:
  - |
    #include <dt-bindings/clock/rockchip,rk3588-cru.h>
    #include <dt-bindings/power/rk3588-power.h>
    #include <dt-bindings/reset/rockchip,rk3588-cru.h>

    bus {
        #address-cells = <2>;
        #size-cells = <2>;

        video-codec@fdc30000 {
            compatible = "rockchip,rk3588-vdec-ccu";
            reg = <0x0 0xfdc30000 0x0 0x100>;
            clocks = <&cru ACLK_RKVDEC_CCU>;
            power-domains = <&power RK3588_PD_RKVDEC0>;
            resets = <&cru SRST_A_RKVDEC_CCU>;
        };
    };

...
```

## Documentation/devicetree/bindings/media/rockchip,rk3588-vepu580.yaml
```yaml
# SPDX-License-Identifier: (GPL-2.0-only OR BSD-2-Clause)
%YAML 1.2
---
$id: http://devicetree.org/schemas/media/rockchip,rk3588-vepu580.yaml#
$schema: http://devicetree.org/meta-schemas/core.yaml#

title: Rockchip VEPU580 video encoder

maintainers:
  - Heiko Stuebner <heiko@sntech.de>

description:
  The VEPU580 (also called RKVENC) is the H.264 and HEVC video encoder of the
  Rockchip RK3588. The SoC has two identical encoder cores, each with its own
  clocks, resets, power domain, interrupt and IOMMU. Every core is described
  by its own node; the operating system may use the cores independently or
  together.

properties:
  compatible:
    const: rockchip,rk3588-vepu580

  reg:
    maxItems: 1

  interrupts:
    maxItems: 1

  clocks:
    items:
      - description: AXI bus clock
      - description: AHB bus clock
      - description: Encoder core clock

  clock-names:
    items:
      - const: aclk
      - const: hclk
      - const: core

  resets:
    items:
      - description: AXI bus reset
      - description: AHB bus reset
      - description: Encoder core reset

  reset-names:
    items:
      - const: aclk
      - const: hclk
      - const: core

  power-domains:
    maxItems: 1

  iommus:
    maxItems: 1

required:
  - compatible
  - reg
  - interrupts
  - clocks
  - clock-names
  - power-domains

additionalProperties: false

examples:
  - |
    #include <dt-bindings/clock/rockchip,rk3588-cru.h>
    #include <dt-bindings/interrupt-controller/arm-gic.h>
    #include <dt-bindings/power/rk3588-power.h>
    #include <dt-bindings/reset/rockchip,rk3588-cru.h>

    bus {
        #address-cells = <2>;
        #size-cells = <2>;

        video-codec@fdbd0000 {
            compatible = "rockchip,rk3588-vepu580";
            reg = <0x0 0xfdbd0000 0x0 0x6000>;
            interrupts = <GIC_SPI 101 IRQ_TYPE_LEVEL_HIGH 0>;
            clocks = <&cru ACLK_RKVENC0>, <&cru HCLK_RKVENC0>,
                     <&cru CLK_RKVENC0_CORE>;
            clock-names = "aclk", "hclk", "core";
            resets = <&cru SRST_A_RKVENC0>, <&cru SRST_H_RKVENC0>,
                     <&cru SRST_RKVENC0_CORE>;
            reset-names = "aclk", "hclk", "core";
            power-domains = <&power RK3588_PD_VENC0>;
            iommus = <&vepu580_0_mmu>;
        };
    };
```

## drivers/media/platform/rockchip/iep/Kconfig
```kconfig
# SPDX-License-Identifier: GPL-2.0-only
config VIDEO_ROCKCHIP_IEP
	tristate "Rockchip IEP2 deinterlacer"
	depends on V4L_MEM2MEM_DRIVERS
	depends on VIDEO_DEV
	depends on ARCH_ROCKCHIP || COMPILE_TEST
	select VIDEOBUF2_DMA_CONTIG
	select V4L2_MEM2MEM_DEV
	help
	  Support for the IEP2 (image enhancement processor) found in the
	  Rockchip RK3568 and RK3588 SoCs. It is exposed as a V4L2 memory to
	  memory device that deinterlaces NV12/NV16 frames, using either
	  intra-field (bob) or motion-adaptive interpolation.

	  To compile this driver as a module, choose M here: the module
	  will be called rockchip-iep.
```

## drivers/media/platform/rockchip/rkjpegd/Kconfig
```kconfig
# SPDX-License-Identifier: GPL-2.0-only
config VIDEO_ROCKCHIP_JPEGD
	tristate "Rockchip VDPU720 JPEG decoder driver"
	depends on ARCH_ROCKCHIP || COMPILE_TEST
	depends on VIDEO_DEV
	select VIDEOBUF2_DMA_CONTIG
	select V4L2_MEM2MEM_DEV
	select V4L2_JPEG_HELPER
	help
	  Support for the VDPU720 baseline JPEG decoder (rkjpegd) found in
	  Rockchip RK3588 SoCs. It is exposed as a stateful V4L2
	  memory-to-memory decoder.

	  To compile this driver as a module, choose M here: the module
	  will be called rockchip-jpegd.
```

## drivers/media/platform/rockchip/rkvenc/Kconfig
```kconfig
# SPDX-License-Identifier: GPL-2.0
config VIDEO_ROCKCHIP_VENC
	tristate "Rockchip VEPU580 stateless video encoder driver"
	depends on ARCH_ROCKCHIP || COMPILE_TEST
	depends on VIDEO_DEV
	select MEDIA_CONTROLLER
	select VIDEOBUF2_DMA_CONTIG
	select V4L2_MEM2MEM_DEV
	select V4L2_H264
	select V4L2_H264_ENC
	select V4L2_HEVC_ENC
	help
	  Support for the VEPU580 (RKVENC) video encoder of the Rockchip
	  RK3588, using the V4L2 stateless encoder interface. H.264 and
	  HEVC are supported.

	  To compile this driver as a module, choose M here: the module
	  will be called rockchip-venc.
```

## drivers/media/v4l2-core/Kconfig
```kconfig
# SPDX-License-Identifier: GPL-2.0-only
#
# Generic video config states
#

config VIDEO_V4L2_I2C
	bool
	depends on I2C && VIDEO_DEV
	default y

config VIDEO_V4L2_SUBDEV_API
	bool
	depends on VIDEO_DEV && MEDIA_CONTROLLER
	help
	  Enables the V4L2 sub-device pad-level userspace API used to configure
	  video format, size and frame rate between hardware blocks.

	  This API is mostly used by camera interfaces in embedded platforms.

config VIDEO_ADV_DEBUG
	bool "Enable advanced debug functionality on V4L2 drivers"
	help
	  Say Y here to enable advanced debugging functionality on some
	  V4L devices.
	  In doubt, say N.

config VIDEO_FIXED_MINOR_RANGES
	bool "Enable old-style fixed minor ranges on drivers/video devices"
	help
	  Say Y here to enable the old-style fixed-range minor assignments.
	  Only useful if you rely on the old behavior and use mknod instead of udev.

	  When in doubt, say N.

# Used by drivers that need tuner.ko
config VIDEO_TUNER
	tristate

# Used by drivers that need v4l2-jpeg.ko
config V4L2_JPEG_HELPER
	tristate

# Used by drivers that need v4l2-h264.ko
config V4L2_H264
	tristate

# Used by drivers that need v4l2-h264-enc.ko
config V4L2_H264_ENC
	tristate

# Used by drivers that need v4l2-hevc-enc-rbsp.ko
config V4L2_HEVC_ENC_RBSP
	tristate

# Used by drivers that need v4l2-hevc-enc.ko
config V4L2_HEVC_ENC
	tristate
	select V4L2_HEVC_ENC_RBSP

config V4L2_HEVC_ENC_RBSP_KUNIT_TEST
	tristate "KUnit tests for the V4L2 HEVC encode RBSP writer" if !KUNIT_ALL_TESTS
	depends on KUNIT
	select V4L2_HEVC_ENC_RBSP
	default KUNIT_ALL_TESTS
	help
	  Build the KUnit tests of the HEVC NAL unit writer used by stateless
	  HEVC encoders. They check the VPS, SPS, PPS, access unit delimiter
	  and slice segment headers it writes, byte for byte, against known
	  bitstreams.

	  If unsure, say N.

# Used by drivers that need v4l2-vp9.ko
config V4L2_VP9
	tristate

# Used by drivers that need v4l2-mem2mem.ko
config V4L2_MEM2MEM_DEV
	tristate
	depends on VIDEOBUF2_CORE

# Used by LED subsystem flash drivers
config V4L2_FLASH_LED_CLASS
	tristate "V4L2 flash API for LED flash class devices"
	depends on VIDEO_DEV
	depends on LEDS_CLASS_FLASH
	select MEDIA_CONTROLLER
	select V4L2_ASYNC
	select VIDEO_V4L2_SUBDEV_API
	help
	  Say Y here to enable V4L2 flash API support for LED flash
	  class drivers.

	  When in doubt, say N.

config V4L2_FWNODE
	tristate
	select V4L2_ASYNC

config V4L2_ASYNC
	tristate

config V4L2_CCI
	tristate

config V4L2_CCI_I2C
	tristate
	depends on I2C
	select REGMAP_I2C
	select V4L2_CCI

config V4L2_ISP
	tristate
	depends on VIDEOBUF2_CORE
```
